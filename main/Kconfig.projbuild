## main/Kconfig.projbuild
```kconfig
menu "Kittyface Audio"

    config KF_I2S_BCLK_GPIO
        int "I2S BCLK GPIO"
        default 21

    config KF_I2S_WS_GPIO
        int "I2S WS/LRCK GPIO"
        default 22

    config KF_I2S_DOUT_GPIO
        int "I2S data out GPIO (amp DIN)"
        default 23

    config KF_SAMPLE_RATE
        int "Sample rate (Hz)"
        default 16000

endmenu
```

## sdkconfig.defaults
```kconfig
CONFIG_IDF_TARGET="esp32c6"
CONFIG_ESPTOOLPY_FLASHSIZE_4MB=y
CONFIG_PARTITION_TABLE_CUSTOM=y
CONFIG_PARTITION_TABLE_CUSTOM_FILENAME="partitions.csv"
CONFIG_PARTITION_TABLE_FILENAME="partitions.csv"
CONFIG_ESP_SYSTEM_EVENT_TASK_STACK_SIZE=4096
CONFIG_ZB_ENABLED=y
CONFIG_ZB_ZCZR=y
CONFIG_ZB_RADIO_NATIVE=y
```
